## app/boards/charles_board/Kconfig.charles_board
```kconfig
# Charles board copied from nucleo_u385rg_q
# Copyright (c) 2025 STMicroelectronics
# SPDX-License-Identifier: Apache-2.0


config BOARD_CHARLES_BOARD
	select SOC_STM32U385XX
```

## app/boards/charles_board/board.yml
```yaml
board:
  name: charles_board
  full_name: Charles board copied from Nucleo U385RG Q
  vendor: charles
  socs:
    - name: stm32u385xx
```

## app/boards/charles_scratch/Kconfig.charles_scratch
```kconfig
#
# Scratch board for ST nucleo_u385rg_q
#

config BOARD_CHARLES_SCRATCH
	select SOC_STM32U385XX
```

## app/boards/charles_scratch/board.yml
```yaml
board:
  name: charles_scratch
  vendor: charles
  socs:
    - name: stm32u385xx
```

## app/drivers/our_sensorled/Kconfig
```kconfig
config OUR_SENSORLED
	bool "Our sensor LED driver"
	default y
	depends on DT_HAS_OUR_SENSORLED_ENABLED
	select GPIO
	help
	  Enables the custom driver for SENSORLED

config OUR_SENSORLED_SHELL
	bool "Our sensor LED driver shell"
	default y
	depends on OUR_SENSORLED && SHELL
	help
	  Enables the custom driver sensorled shell
```

## twister-out/native_sim_native/host/homework.unit.ring_buf/Kconfig/arch/Kconfig
```kconfig
# Load Zephyr Arch Kconfig descriptions.
osource "/opt/zephyr/iomico-zephyr-fundamentals/module02/deps/zephyr/arch/rx/Kconfig"
osource "/opt/zephyr/iomico-zephyr-fundamentals/module02/deps/zephyr/arch/x86/Kconfig"
osource "/opt/zephyr/iomico-zephyr-fundamentals/module02/deps/zephyr/arch/xtensa/Kconfig"
osource "/opt/zephyr/iomico-zephyr-fundamentals/module02/deps/zephyr/arch/sparc/Kconfig"
osource "/opt/zephyr/iomico-zephyr-fundamentals/module02/deps/zephyr/arch/riscv/Kconfig"
osource "/opt/zephyr/iomico-zephyr-fundamentals/module02/deps/zephyr/arch/posix/Kconfig"
osource "/opt/zephyr/iomico-zephyr-fundamentals/module02/deps/zephyr/arch/mips/Kconfig"
osource "/opt/zephyr/iomico-zephyr-fundamentals/module02/deps/zephyr/arch/arm64/Kconfig"
osource "/opt/zephyr/iomico-zephyr-fundamentals/module02/deps/zephyr/arch/arm/Kconfig"
osource "/opt/zephyr/iomico-zephyr-fundamentals/module02/deps/zephyr/arch/arc/Kconfig"
```

## twister-out/native_sim_native/host/homework.unit.ring_buf/Kconfig/boards/Kconfig.defconfig
```kconfig
# Load Zephyr board defconfig descriptions.
osource "/opt/zephyr/iomico-zephyr-fundamentals/module02/deps/zephyr/boards/native/native_sim/Kconfig.defconfig"
```

## twister-out/native_sim_native/host/homework.unit.ring_buf/Kconfig/boards/Kconfig.native_sim
```kconfig
# Load board Kconfig descriptions.
osource "/opt/zephyr/iomico-zephyr-fundamentals/module02/deps/zephyr/boards/native/native_sim/Kconfig.native_sim"
```

## twister-out/native_sim_native/host/homework.unit.ring_buf/Kconfig/soc/Kconfig.sysbuild
```kconfig
# Load Sysbuild SoC Kconfig descriptions.
osource "/opt/zephyr/iomico-zephyr-fundamentals/module02/deps/zephyr/soc/xlnx/zynqmp/Kconfig.sysbuild"
osource "/opt/zephyr/iomico-zephyr-fundamentals/module02/deps/zephyr/soc/xlnx/zynq7000/Kconfig.sysbuild"
osource "/opt/zephyr/iomico-zephyr-fundamentals/module02/deps/zephyr/soc/xlnx/versalnet/Kconfig.sysbuild"
osource "/opt/zephyr/iomico-zephyr-fundamentals/module02/deps/zephyr/soc/xlnx/versal2/Kconfig.sysbuild"
osource "/opt/zephyr/iomico-zephyr-fundamentals/module02/deps/zephyr/soc/xen/Kconfig.sysbuild"
osource "/opt/zephyr/iomico-zephyr-fundamentals/module02/deps/zephyr/soc/wch/ch32v/Kconfig.sysbuild"
osource "/opt/zephyr/iomico-zephyr-fundamentals/module02/deps/zephyr/soc/ti/simplelink/Kconfig.sysbuild"
osource "/opt/zephyr/iomico-zephyr-fundamentals/module02/deps/zephyr/soc/ti/mspm0/Kconfig.sysbuild"
osource "/opt/zephyr/iomico-zephyr-fundamentals/module02/deps/zephyr/soc/ti/lm3s6965/Kconfig.sysbuild"
osource "/opt/zephyr/iomico-zephyr-fundamentals/module02/deps/zephyr/soc/ti/k3/Kconfig.sysbuild"
osource "/opt/zephyr/iomico-zephyr-fundamentals/module02/deps/zephyr/soc/telink/tlsr/Kconfig.sysbuild"
osource "/opt/zephyr/iomico-zephyr-fundamentals/module02/deps/zephyr/soc/starfive/jh71xx/Kconfig.sysbuild"
osource "/opt/zephyr/iomico-zephyr-fundamentals/module02/deps/zephyr/soc/st/stm32/Kconfig.sysbuild"
osource "/opt/zephyr/iomico-zephyr-fundamentals/module02/deps/zephyr/soc/snps/qemu_arc/Kconfig.sysbuild"
osource "/opt/zephyr/iomico-zephyr-fundamentals/module02/deps/zephyr/soc/snps/nsim/arc_v/Kconfig.sysbuild"
osource "/opt/zephyr/iomico-zephyr-fundamentals/module02/deps/zephyr/soc/snps/nsim/arc_classic/Kconfig.sysbuild"
osource "/opt/zephyr/iomico-zephyr-fundamentals/module02/deps/zephyr/soc/snps/hsdk4xd/Kconfig.sysbuild"
osource "/opt/zephyr/iomico-zephyr-fundamentals/module02/deps/zephyr/soc/snps/hsdk/Kconfig.sysbuild"
osource "/opt/zephyr/iomico-zephyr-fundamentals/module02/deps/zephyr/soc/snps/emsk/Kconfig.sysbuild"
osource "/opt/zephyr/iomico-zephyr-fundamentals/module02/deps/zephyr/soc/snps/emsdp/Kconfig.sysbuild"
osource "/opt/zephyr/iomico-zephyr-fundamentals/module02/deps/zephyr/soc/snps/arc_iot/Kconfig.sysbuild"
osource "/opt/zephyr/iomico-zephyr-fundamentals/module02/deps/zephyr/soc/silabs/Kconfig.sysbuild"
osource "/opt/zephyr/iomico-zephyr-fundamentals/module02/deps/zephyr/soc/sifive/sifive_freedom/Kconfig.sysbuild"
osource "/opt/zephyr/iomico-zephyr-fundamentals/module02/deps/zephyr/soc/sensry/Kconfig.sysbuild"
osource "/opt/zephyr/iomico-zephyr-fundamentals/module02/deps/zephyr/soc/rockchip/Kconfig.sysbuild"
osource "/opt/zephyr/iomico-zephyr-fundamentals/module02/deps/zephyr/soc/renode/riscv_virtual/Kconfig.sysbuild"
osource "/opt/zephyr/iomico-zephyr-fundamentals/module02/deps/zephyr/soc/renode/cortex_r8_virtual/Kconfig.sysbuild"
osource "/opt/zephyr/iomico-zephyr-fundamentals/module02/deps/zephyr/soc/renesas/smartbond/Kconfig.sysbuild"
osource "/opt/zephyr/iomico-zephyr-fundamentals/module02/deps/zephyr/soc/renesas/rz/Kconfig.sysbuild"
osource "/opt/zephyr/iomico-zephyr-fundamentals/module02/deps/zephyr/soc/renesas/rx/Kconfig.sysbuild"
osource "/opt/zephyr/iomico-zephyr-fundamentals/module02/deps/zephyr/soc/renesas/rcar/Kconfig.sysbuild"
osource "/opt/zephyr/iomico-zephyr-fundamentals/module02/deps/zephyr/soc/renesas/ra/Kconfig.sysbuild"
osource "/opt/zephyr/iomico-zephyr-fundamentals/module02/deps/zephyr/soc/realtek/ec/Kconfig.sysbuild"
osource "/opt/zephyr/iomico-zephyr-fundamentals/module02/deps/zephyr/soc/raspberrypi/rpi_pico/Kconfig.sysbuild"
osource "/opt/zephyr/iomico-zephyr-fundamentals/module02/deps/zephyr/soc/quicklogic/eos_s3/Kconfig.sysbuild"
osource "/opt/zephyr/iomico-zephyr-fundamentals/module02/deps/zephyr/soc/qemu/virt_riscv/Kconfig.sysbuild"
osource "/opt/zephyr/iomico-zephyr-fundamentals/module02/deps/zephyr/soc/qemu/malta/Kconfig.sysbuild"
osource "/opt/zephyr/iomico-zephyr-fundamentals/module02/deps/zephyr/soc/openisa/rv32m1/Kconfig.sysbuild"
osource "/opt/zephyr/iomico-zephyr-fundamentals/module02/deps/zephyr/soc/openhwgroup/cva6/Kconfig.sysbuild"
osource "/opt/zephyr/iomico-zephyr-fundamentals/module02/deps/zephyr/soc/oct/osd32mp15x/Kconfig.sysbuild"
osource "/opt/zephyr/iomico-zephyr-fundamentals/module02/deps/zephyr/soc/nxp/s32/Kconfig.sysbuild"
osource "/opt/zephyr/iomico-zephyr-fundamentals/module02/deps/zephyr/soc/nxp/rw/Kconfig.sysbuild"
osource "/opt/zephyr/iomico-zephyr-fundamentals/module02/deps/zephyr/soc/nxp/mcx/Kconfig.sysbuild"
osource "/opt/zephyr/iomico-zephyr-fundamentals/module02/deps/zephyr/soc/nxp/lpc/Kconfig.sysbuild"
osource "/opt/zephyr/iomico-zephyr-fundamentals/module02/deps/zephyr/soc/nxp/layerscape/Kconfig.sysbuild"
osource "/opt/zephyr/iomico-zephyr-fundamentals/module02/deps/zephyr/soc/nxp/kinetis/Kconfig.sysbuild"
osource "/opt/zephyr/iomico-zephyr-fundamentals/module02/deps/zephyr/soc/nxp/imxrt/Kconfig.sysbuild"
osource "/opt/zephyr/iomico-zephyr-fundamentals/module02/deps/zephyr/soc/nxp/imx/Kconfig.sysbuild"
osource "/opt/zephyr/iomico-zephyr-fundamentals/module02/deps/zephyr/soc/nuvoton/numicro/Kconfig.sysbuild"
osource "/opt/zephyr/iomico-zephyr-fundamentals/module02/deps/zephyr/soc/nuvoton/numaker/Kconfig.sysbuild"
osource "/opt/zephyr/iomico-zephyr-fundamentals/module02/deps/zephyr/soc/nuvoton/npcx/Kconfig.sysbuild"
osource "/opt/zephyr/iomico-zephyr-fundamentals/module02/deps/zephyr/soc/nuvoton/npcm/Kconfig.sysbuild"
osource "/opt/zephyr/iomico-zephyr-fundamentals/module02/deps/zephyr/soc/nordic/Kconfig.sysbuild"
osource "/opt/zephyr/iomico-zephyr-fundamentals/module02/deps/zephyr/soc/neorv32/Kconfig.sysbuild"
osource "/opt/zephyr/iomico-zephyr-fundamentals/module02/deps/zephyr/soc/native/inf_clock/Kconfig.sysbuild"
osource "/opt/zephyr/iomico-zephyr-fundamentals/module02/deps/zephyr/soc/microchip/sam/Kconfig.sysbuild"
osource "/opt/zephyr/iomico-zephyr-fundamentals/module02/deps/zephyr/soc/microchip/miv/Kconfig.sysbuild"
osource "/opt/zephyr/iomico-zephyr-fundamentals/module02/deps/zephyr/soc/microchip/mec/Kconfig.sysbuild"
osource "/opt/zephyr/iomico-zephyr-fundamentals/module02/deps/zephyr/soc/mediatek/mt8xxx/Kconfig.sysbuild"
osource "/opt/zephyr/iomico-zephyr-fundamentals/module02/deps/zephyr/soc/lowrisc/opentitan/Kconfig.sysbuild"
osource "/opt/zephyr/iomico-zephyr-fundamentals/module02/deps/zephyr/soc/litex/litex_vexriscv/Kconfig.sysbuild"
osource "/opt/zephyr/iomico-zephyr-fundamentals/module02/deps/zephyr/soc/ite/ec/Kconfig.sysbuild"
osource "/opt/zephyr/iomico-zephyr-fundamentals/module02/deps/zephyr/soc/intel/raptor_lake/Kconfig.sysbuild"
osource "/opt/zephyr/iomico-zephyr-fundamentals/module02/deps/zephyr/soc/intel/lakemont/Kconfig.sysbuild"
osource "/opt/zephyr/iomico-zephyr-fundamentals/module02/deps/zephyr/soc/intel/intel_socfpga_std/Kconfig.sysbuild"
osource "/opt/zephyr/iomico-zephyr-fundamentals/module02/deps/zephyr/soc/intel/intel_socfpga/Kconfig.sysbuild"
osource "/opt/zephyr/iomico-zephyr-fundamentals/module02/deps/zephyr/soc/intel/intel_niosv/Kconfig.sysbuild"
osource "/opt/zephyr/iomico-zephyr-fundamentals/module02/deps/zephyr/soc/intel/intel_ish/Kconfig.sysbuild"
osource "/opt/zephyr/iomico-zephyr-fundamentals/module02/deps/zephyr/soc/intel/intel_adsp/Kconfig.sysbuild"
osource "/opt/zephyr/iomico-zephyr-fundamentals/module02/deps/zephyr/soc/intel/elkhart_lake/Kconfig.sysbuild"
osource "/opt/zephyr/iomico-zephyr-fundamentals/module02/deps/zephyr/soc/intel/atom/Kconfig.sysbuild"
osource "/opt/zephyr/iomico-zephyr-fundamentals/module02/deps/zephyr/soc/intel/apollo_lake/Kconfig.sysbuild"
osource "/opt/zephyr/iomico-zephyr-fundamentals/module02/deps/zephyr/soc/intel/alder_lake/Kconfig.sysbuild"
osource "/opt/zephyr/iomico-zephyr-fundamentals/module02/deps/zephyr/soc/infineon/cat3/Kconfig.sysbuild"
osource "/opt/zephyr/iomico-zephyr-fundamentals/module02/deps/zephyr/soc/infineon/cat1c/Kconfig.sysbuild"
osource "/opt/zephyr/iomico-zephyr-fundamentals/module02/deps/zephyr/soc/infineon/cat1b/Kconfig.sysbuild"
osource "/opt/zephyr/iomico-zephyr-fundamentals/module02/deps/zephyr/soc/infineon/cat1a/Kconfig.sysbuild"
osource "/opt/zephyr/iomico-zephyr-fundamentals/module02/deps/zephyr/soc/gd/gd32/Kconfig.sysbuild"
osource "/opt/zephyr/iomico-zephyr-fundamentals/module02/deps/zephyr/soc/gaisler/leon3/Kconfig.sysbuild"
osource "/opt/zephyr/iomico-zephyr-fundamentals/module02/deps/zephyr/soc/gaisler/gr716a/Kconfig.sysbuild"
osource "/opt/zephyr/iomico-zephyr-fundamentals/module02/deps/zephyr/soc/espressif/Kconfig.sysbuild"
osource "/opt/zephyr/iomico-zephyr-fundamentals/module02/deps/zephyr/soc/ene/kb1200/Kconfig.sysbuild"
osource "/opt/zephyr/iomico-zephyr-fundamentals/module02/deps/zephyr/soc/ene/kb106x/Kconfig.sysbuild"
osource "/opt/zephyr/iomico-zephyr-fundamentals/module02/deps/zephyr/soc/efinix/sapphire/Kconfig.sysbuild"
osource "/opt/zephyr/iomico-zephyr-fundamentals/module02/deps/zephyr/soc/cdns/xtensa_sample_controller/Kconfig.sysbuild"
osource "/opt/zephyr/iomico-zephyr-fundamentals/module02/deps/zephyr/soc/cdns/sample_controller32/Kconfig.sysbuild"
osource "/opt/zephyr/iomico-zephyr-fundamentals/module02/deps/zephyr/soc/cdns/dc233c/Kconfig.sysbuild"
osource "/opt/zephyr/iomico-zephyr-fundamentals/module02/deps/zephyr/soc/brcm/bcmvk/Kconfig.sysbuild"
osource "/opt/zephyr/iomico-zephyr-fundamentals/module02/deps/zephyr/soc/brcm/bcm2712/Kconfig.sysbuild"
osource "/opt/zephyr/iomico-zephyr-fundamentals/module02/deps/zephyr/soc/brcm/bcm2711/Kconfig.sysbuild"
osource "/opt/zephyr/iomico-zephyr-fundamentals/module02/deps/zephyr/soc/bflb/Kconfig.sysbuild"
osource "/opt/zephyr/iomico-zephyr-fundamentals/module02/deps/zephyr/soc/atmel/sam0/Kconfig.sysbuild"
osource "/opt/zephyr/iomico-zephyr-fundamentals/module02/deps/zephyr/soc/atmel/sam/Kconfig.sysbuild"
osource "/opt/zephyr/iomico-zephyr-fundamentals/module02/deps/zephyr/soc/aspeed/Kconfig.sysbuild"
osource "/opt/zephyr/iomico-zephyr-fundamentals/module02/deps/zephyr/soc/arm/Kconfig.sysbuild"
osource "/opt/zephyr/iomico-zephyr-fundamentals/module02/deps/zephyr/soc/arm/beetle/Kconfig.sysbuild"
osource "/opt/zephyr/iomico-zephyr-fundamentals/module02/deps/zephyr/soc/antmicro/myra/Kconfig.sysbuild"
osource "/opt/zephyr/iomico-zephyr-fundamentals/module02/deps/zephyr/soc/andestech/Kconfig.sysbuild"
osource "/opt/zephyr/iomico-zephyr-fundamentals/module02/deps/zephyr/soc/amd/acp_6_0/Kconfig.sysbuild"
osource "/opt/zephyr/iomico-zephyr-fundamentals/module02/deps/zephyr/soc/ambiq/Kconfig.sysbuild"
osource "/opt/zephyr/iomico-zephyr-fundamentals/module02/deps/zephyr/soc/aesc/Kconfig.sysbuild"
osource "/opt/zephyr/iomico-zephyr-fundamentals/module02/deps/zephyr/soc/adi/max32/Kconfig.sysbuild"
```
